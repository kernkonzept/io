## io/Kconfig.L4
```kconfig
menu "io platform manager"

config L4IO_ACPI
	bool "Include the ACPI subsystem" if !BUILD_ARCH_x86 && !BUILD_ARCH_amd64
	depends on BUILD_ARCH_x86 || BUILD_ARCH_amd64
	default y
	select L4IO_PCI

config L4IO_PCI
	bool "Include the PCI subsystem"
	select L4IO_SCU_IMX8QM
	default y

config L4IO_PCIID_DB
	bool "Include PCI-ID database for descriptive PCI devices"
	depends on L4IO_PCI
	default y

menu "Device drivers"

source "server/src/drivers/Kconfig.L4"

source "server/src/drivers/gpio/Kconfig.L4"

endmenu

endmenu
```

## io/server/src/drivers/Kconfig.L4
```kconfig
config L4IO_SCU_IMX8QM
	bool "NXP i.MX8QM SCU"
	default y
	help
		Add support for i.MX8 System Controller Unit found on the NXP i.MX8QM.

config L4IO_IOMUXC_IMX8MP
	bool "NXP i.MX8MP IOMUXC Driver"
	default y
	help
		Add support for i.MX8 IOMUXC controller found on the NXP i.MX8MP.

config L4IO_PCI_TEGRA_PCIE
	bool "NVIDIA Tegra194 PCIe controller Driver"
	default y
	depends on L4IO_PCI
	depends on HAVE_BIDPC_LIBTEGRA_BPMP
	depends on HAVE_BIDPC_LIBTEGRA_PWM
	help
		Add support for NVIDIA Tegra194 PCIe controller.
```

## io/server/src/drivers/gpio/Kconfig.L4
```kconfig
comment "GPIO Drivers"

config L4IO_GPIO_BCM2835
	bool "Broadcom BCM2835"
	default y
	help
		Add support for Broadcom BCM2835 gpio chip

config L4IO_GPIO_OMAP
	bool "OMAP35x, OMAP44x, OMAP54x"
	default y
	help
		Add support for the OMAP3/4/5 GPIO chips (omap35x,omap44x,omap54x)

config L4IO_GPIO_QCOM
	bool "GPIO Qualcomm TLMM"
	default y
	help
		Add support for the Qualcomm "Top-Level Mode Multiplexer" (TLMM) GPIO
		controller used in most Qualcomm Snapdragon chips (e.g. MSM8916).

config L4IO_GPIO_IMX
	bool "GPIO IMX / IMX8QM"
	default y
	select L4IO_SCU_IMX8QM
	help
		Add support for the IMX / IMX8 GPIO chips.
```
